#include "oled_ssd1306.h"

#include <string.h>

#include "driver/gpio.h"
#include "driver/i2c.h"
#include "freertos/FreeRTOS.h"
#include "freertos/task.h"
#include "esp_log.h"
#include "esp_check.h"

#define OLED_WIDTH   128
#define OLED_HEIGHT   64
#define OLED_PAGES   (OLED_HEIGHT / 8)

static const char *TAG = "OLED";
static uint8_t s_fb[OLED_WIDTH * OLED_PAGES];
static oled_ssd1306_cfg_t s_cfg;
static bool s_ready = false;

/* 5x7 ASCII font (0x20~0x7E), columns LSB-top */
static const uint8_t s_font5x7[][5] = {
    {0x00,0x00,0x00,0x00,0x00}, {0x00,0x00,0x5F,0x00,0x00}, {0x00,0x07,0x00,0x07,0x00}, {0x14,0x7F,0x14,0x7F,0x14},
    {0x24,0x2A,0x7F,0x2A,0x12}, {0x23,0x13,0x08,0x64,0x62}, {0x36,0x49,0x55,0x22,0x50}, {0x00,0x05,0x03,0x00,0x00},
    {0x00,0x1C,0x22,0x41,0x00}, {0x00,0x41,0x22,0x1C,0x00}, {0x14,0x08,0x3E,0x08,0x14}, {0x08,0x08,0x3E,0x08,0x08},
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    {0x00,0x00,0x7F,0x00,0x00}, {0x00,0x41,0x36,0x08,0x00}, {0x08,0x08,0x2A,0x1C,0x08}
};

static esp_err_t oled_write_cmd(uint8_t cmd)
{
    uint8_t payload[2] = {0x00, cmd};
    return i2c_master_write_to_device(s_cfg.i2c_port, s_cfg.i2c_addr, payload, sizeof(payload),
                                      pdMS_TO_TICKS(100));
}

static esp_err_t oled_write_data(const uint8_t *data, size_t len)
{
    /* One control byte (0x40) + data chunk */
    uint8_t buf[17];
    buf[0] = 0x40;
    while (len > 0) {
        size_t chunk = (len > 16) ? 16 : len;
        memcpy(&buf[1], data, chunk);
        esp_err_t ret = i2c_master_write_to_device(s_cfg.i2c_port, s_cfg.i2c_addr, buf, chunk + 1,
                                                   pdMS_TO_TICKS(100));
        if (ret != ESP_OK) return ret;
        data += chunk;
        len  -= chunk;
    }
    return ESP_OK;
}

static void oled_draw_pixel(int x, int y, bool on)
{
    if (x < 0 || x >= OLED_WIDTH || y < 0 || y >= OLED_HEIGHT) return;
    int page = y / 8;
    int bit  = y % 8;
    uint8_t *cell = &s_fb[page * OLED_WIDTH + x];
    if (on) *cell |=  (1u << bit);
    else    *cell &= ~(1u << bit);
}

static void oled_draw_char(int x, int y, char c)
{
    if (c < 0x20 || c > 0x7E) c = '?';
    const uint8_t *glyph = s_font5x7[(int)c - 0x20];
    for (int col = 0; col < 5; ++col) {
        uint8_t bits = glyph[col];
        for (int row = 0; row < 7; ++row) {
            oled_draw_pixel(x + col, y + row, (bits >> row) & 0x01);
        }
    }
}

esp_err_t oled_ssd1306_init(const oled_ssd1306_cfg_t *cfg)
{
    if (cfg == NULL) return ESP_ERR_INVALID_ARG;
    s_cfg = *cfg;

    i2c_config_t i2c_cfg = {
        .mode = I2C_MODE_MASTER,
        .sda_io_num = s_cfg.sda_io_num,
        .scl_io_num = s_cfg.scl_io_num,
        .sda_pullup_en = GPIO_PULLUP_ENABLE,
        .scl_pullup_en = GPIO_PULLUP_ENABLE,
        .master.clk_speed = s_cfg.i2c_clk_hz,
        .clk_flags = 0,
    };
    ESP_ERROR_CHECK(i2c_param_config(s_cfg.i2c_port, &i2c_cfg));
    ESP_ERROR_CHECK(i2c_driver_install(s_cfg.i2c_port, I2C_MODE_MASTER, 0, 0, 0));

    if (s_cfg.rst_io_num >= 0) {
        gpio_config_t rst_cfg = {
            .pin_bit_mask = (1ULL << s_cfg.rst_io_num),
            .mode = GPIO_MODE_OUTPUT,
            .pull_down_en = GPIO_PULLDOWN_DISABLE,
            .pull_up_en = GPIO_PULLUP_DISABLE,
            .intr_type = GPIO_INTR_DISABLE,
        };
        ESP_ERROR_CHECK(gpio_config(&rst_cfg));
        gpio_set_level(s_cfg.rst_io_num, 0);
        vTaskDelay(pdMS_TO_TICKS(30));
        gpio_set_level(s_cfg.rst_io_num, 1);
    }
    vTaskDelay(pdMS_TO_TICKS(50));

    ESP_ERROR_CHECK(oled_write_cmd(0xAE)); /* Display OFF */
    ESP_ERROR_CHECK(oled_write_cmd(0x20)); ESP_ERROR_CHECK(oled_write_cmd(0x00)); /* horizontal */
    ESP_ERROR_CHECK(oled_write_cmd(0x21)); ESP_ERROR_CHECK(oled_write_cmd(0x00)); ESP_ERROR_CHECK(oled_write_cmd(0x7F));
    ESP_ERROR_CHECK(oled_write_cmd(0x22)); ESP_ERROR_CHECK(oled_write_cmd(0x00)); ESP_ERROR_CHECK(oled_write_cmd(0x07));
    ESP_ERROR_CHECK(oled_write_cmd(0x40)); /* start line */
    ESP_ERROR_CHECK(oled_write_cmd(s_cfg.flip_vertical ? 0xA0 : 0xA1)); /* seg remap */
    ESP_ERROR_CHECK(oled_write_cmd(s_cfg.flip_vertical ? 0xC0 : 0xC8)); /* com scan dir */
    ESP_ERROR_CHECK(oled_write_cmd(0xA8)); ESP_ERROR_CHECK(oled_write_cmd(0x3F)); /* mux */
    ESP_ERROR_CHECK(oled_write_cmd(0xD3)); ESP_ERROR_CHECK(oled_write_cmd(0x00)); /* offset */
    ESP_ERROR_CHECK(oled_write_cmd(0xDA)); ESP_ERROR_CHECK(oled_write_cmd(0x12)); /* com pins */
    ESP_ERROR_CHECK(oled_write_cmd(0xD5)); ESP_ERROR_CHECK(oled_write_cmd(0x80)); /* clk divide */
    ESP_ERROR_CHECK(oled_write_cmd(0xD9)); ESP_ERROR_CHECK(oled_write_cmd(0xF1)); /* pre-charge */
    ESP_ERROR_CHECK(oled_write_cmd(0xDB)); ESP_ERROR_CHECK(oled_write_cmd(0x40)); /* vcomh */
    ESP_ERROR_CHECK(oled_write_cmd(0x8D)); ESP_ERROR_CHECK(oled_write_cmd(0x14)); /* charge pump on */
    ESP_ERROR_CHECK(oled_write_cmd(0xA4)); /* resume RAM content */
    ESP_ERROR_CHECK(oled_write_cmd(0xA6)); /* normal display */
    ESP_ERROR_CHECK(oled_write_cmd(0x2E)); /* deactivate scroll */
    ESP_ERROR_CHECK(oled_write_cmd(0xAF)); /* Display ON */

    s_ready = true;
    oled_ssd1306_clear();
    oled_ssd1306_refresh();
    ESP_LOGI(TAG, "SSD1306 init done (addr=0x%02X, SDA=%d, SCL=%d)",
             s_cfg.i2c_addr, s_cfg.sda_io_num, s_cfg.scl_io_num);
    return ESP_OK;
}

void oled_ssd1306_clear(void)
{
    memset(s_fb, 0x00, sizeof(s_fb));
}

void oled_ssd1306_draw_text(int col, int row, const char *text)
{
    if (!text) return;
    int x = col * 6;
    int y = row * 8;
    while (*text && x <= OLED_WIDTH - 6) {
        oled_draw_char(x, y, *text++);
        x += 6;
    }
}

void oled_ssd1306_draw_hbar(int x, int y, int width, int height, uint8_t percent)
{
    if (width <= 1 || height <= 1) return;
    if (percent > 100) percent = 100;
    int fill_w = (width - 2) * percent / 100;

    for (int xx = x; xx < x + width; ++xx) {
        oled_draw_pixel(xx, y, true);
        oled_draw_pixel(xx, y + height - 1, true);
    }
    for (int yy = y; yy < y + height; ++yy) {
        oled_draw_pixel(x, yy, true);
        oled_draw_pixel(x + width - 1, yy, true);
    }
    for (int yy = y + 1; yy < y + height - 1; ++yy) {
        for (int xx = x + 1; xx < x + width - 1; ++xx) {
            oled_draw_pixel(xx, yy, (xx - (x + 1)) < fill_w);
        }
    }
}

void oled_ssd1306_refresh(void)
{
    if (!s_ready) return;
    ESP_ERROR_CHECK_WITHOUT_ABORT(oled_write_cmd(0x21));
    ESP_ERROR_CHECK_WITHOUT_ABORT(oled_write_cmd(0x00));
    ESP_ERROR_CHECK_WITHOUT_ABORT(oled_write_cmd(0x7F));
    ESP_ERROR_CHECK_WITHOUT_ABORT(oled_write_cmd(0x22));
    ESP_ERROR_CHECK_WITHOUT_ABORT(oled_write_cmd(0x00));
    ESP_ERROR_CHECK_WITHOUT_ABORT(oled_write_cmd(0x07));
    ESP_ERROR_CHECK_WITHOUT_ABORT(oled_write_data(s_fb, sizeof(s_fb)));
}
