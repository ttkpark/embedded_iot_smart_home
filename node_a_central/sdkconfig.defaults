## node_a_central/sdkconfig.defaults
```kconfig
# Node A sdkconfig.defaults

# Flash 4MB (app0 + SPIFFS 2MB partition)
CONFIG_ESPTOOLPY_FLASHSIZE_4MB=y

# Custom partition table (SPIFFS)
CONFIG_PARTITION_TABLE_CUSTOM=y
CONFIG_PARTITION_TABLE_CUSTOM_FILENAME="partitions.csv"

# WebSocket support (esp_http_server)
CONFIG_HTTPD_WS_SUPPORT=y
CONFIG_HTTPD_MAX_REQ_HDR_LEN=1024
CONFIG_HTTPD_MAX_URI_LEN=512

# Main task stack size (SPIFFS + HTTP)
CONFIG_ESP_MAIN_TASK_STACK_SIZE=8192

# FreeRTOS tick rate
CONFIG_FREERTOS_HZ=1000

# BLE (NimBLE — 경량, Wi-Fi 동시 사용 가능)
CONFIG_BT_ENABLED=y
CONFIG_BT_NIMBLE_ENABLED=y
CONFIG_BT_NIMBLE_MAX_CONNECTIONS=3
CONFIG_BT_NIMBLE_ROLE_PERIPHERAL=y
CONFIG_BT_NIMBLE_ROLE_CENTRAL=n
CONFIG_BT_NIMBLE_ROLE_OBSERVER=n
CONFIG_BT_NIMBLE_ROLE_BROADCASTER=y

# Log level (INFO for dev, WARN for release)
CONFIG_LOG_DEFAULT_LEVEL_INFO=y
```
